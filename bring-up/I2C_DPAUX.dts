        miscreg-dpaux@00100000 {

                compatible = "nvidia,tegra194-misc-dpaux-padctl";
                reg = <0x0 0x00100000 0x0 0xf000>;
                dpaux_default: pinmux@0 {

                        dpaux0_pins {
                                pins = "dpaux-0";
                                function = "i2c";
                        };
                };
        };

        i2c@31b0000 {
                pinctrl-names = "default";
                pinctrl-0 = <&dpaux_default>;
                status = "okay";
        };


// SPDX-License-Identifier: GPL-2.0-only
// SPDX-FileCopyrightText: Copyright (c) 2023, NVIDIA CORPORATION & AFFILIATES.  All rights reserved.

/dts-v1/;

#include "tegra234-novacarrier+p3767-0000.dts"
#include "tegra234-novacarrier+p3767-xxxx-nv-common.dtsi"
